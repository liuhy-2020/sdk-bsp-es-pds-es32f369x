## rtt_default_project_0/drivers/Kconfig
```kconfig
menu "Hardware Drivers Config"

    

    menu "On-chip Peripheral Drivers"
        config BSP_USING_GPIO
            bool "Enable GPIO"
            select RT_USING_PIN
            default y

    source "drivers/ES/Kconfig"    

    endmenu

    menu "Onboard Peripheral Drivers"

    endmenu

    menu "Offboard Peripheral Drivers"

    endmenu


    menu "Peripheral Drivers test example"

        config BSP_USING_EXAMPLE_ADC_VOL
            bool "BSP_USING_EXAMPLE_ADC_VOL"
            default n
        
        config BSP_USING_EXAMPLE_HWTIMER
            bool "BSP_USING_EXAMPLE_HWTIMER"
            default n

        config BSP_USING_EXAMPLE_I2C
            bool "BSP_USING_EXAMPLE_I2C"
            default n

        config BSP_USING_EXAMPLE_LED_BLINK
            bool "BSP_USING_EXAMPLE_LED_BLINK"
            default n

        config BSP_USING_EXAMPLE_PIN_BEEP
            bool "BSP_USING_EXAMPLE_PIN_BEEP"
            default n

        config BSP_USING_EXAMPLE_PWM_LED
            bool "BSP_USING_EXAMPLE_PWM_LED"
            default n

        config BSP_USING_EXAMPLE_RTC
            bool "BSP_USING_EXAMPLE_RTC"
            default n

        config BSP_USING_EXAMPLE_SPI
            bool "BSP_USING_EXAMPLE_SPI"
            default n

        config BSP_USING_EXAMPLE_UART
            bool "BSP_USING_EXAMPLE_UART"
            default n

        config BSP_USING_EXAMPLE_CAN
            bool "BSP_USING_EXAMPLE_CAN"
            default n

        config BSP_USING_EXAMPLE_PM
            bool "BSP_USING_EXAMPLE_PM"
            default n

    endmenu

endmenu
```
